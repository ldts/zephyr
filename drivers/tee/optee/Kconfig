## drivers/tee/optee/Kconfig
```kconfig
# Copyright (c) 2023 EPAM Systems
# SPDX-License-Identifier: Apache-2.0

config OPTEE
	bool "OP-TEE driver"
	depends on (ARM64 && ARMV8_A_NS && HAS_ARM_SMCCC) || ZTEST
	help
	  This implements support of the OP-TEE firmware which is loaded
	  as BL32 image. OP-TEE is a Trust Zone OS which implements mechanisms
	  of the hardware isolation and rely to ARM TrustZone technology.
	  Driver requests functions from the OP-TEE and implements RPC mechanism
	  needed by OP-TEE to run services. See https://www.op-tee.org for more
	  information.

config OPTEE_MAX_NOTIF
	int "Max number of OP-TEE notifications"
	depends on OPTEE
	default $(UINT8_MAX)
	help
	 Sets the maximum notifications from OP-TEE to the Normal World. OP-TEE using
	 this mechanism for the synchronization.

config OPTEE_FFA
	bool "OP-TEE Trusted OS via FF-A transport"
	depends on ARM_FFA && ARM_FFA_MEM_SHARE
	select TEE
	help
	  Enables the OP-TEE driver using the Arm FF-A conduit instead of
	  direct SMC calls.  Discovers the OP-TEE Secure Partition via
	  FFA_PARTITION_INFO_GET, negotiates the OP-TEE protocol with
	  OPTEE_FFA_GET_API_VERSION / EXCHANGE_CAPABILITIES, and issues
	  yielding calls via FFA_MSG_SEND_DIRECT_REQ.  Shared memory is
	  registered with FFA_MEM_SHARE and reclaimed after use.

  Requires CONFIG_ARM_FFA=y and CONFIG_ARM_FFA_MEM_SHARE=y.

config OPTEE_FFA_MAX_NOTIF
	int "Max OP-TEE FF-A notification IDs"
	depends on OPTEE_FFA
	default $(UINT8_MAX)
	help
	  Maximum OP-TEE notification key value for the FF-A transport.
```

## dts/bindings/arm/linaro,optee-ffa.yaml
```yaml
# Copyright 2026 Qualcomm Innovation Center, Inc.
# SPDX-License-Identifier: Apache-2.0

description: OP-TEE Trusted OS accessed via Arm FF-A transport

compatible: "linaro,optee-ffa"

include: base.yaml

properties:
  method:
    type: string
    required: true
    description: |
      FF-A conduit: "smc" for SMC-based FF-A (most common), "hvc" for
      hypervisor-call-based FF-A.
    enum:
      - smc
      - hvc
```

## subsys/firmware/Kconfig
```kconfig
# Copyright 2026 Qualcomm Innovation Center, Inc.
# SPDX-License-Identifier: Apache-2.0

menu "Firmware"

source "subsys/firmware/ffa/Kconfig"

endmenu
```

## subsys/firmware/ffa/Kconfig
```kconfig
# Copyright 2026 Qualcomm Innovation Center, Inc.
# SPDX-License-Identifier: Apache-2.0

config ARM_FFA
	bool "Arm Firmware Framework for A-profile (FF-A) core"
	depends on ARM64 && HAS_ARM_SMCCC
	select ARM_SMCCC_1_2
	help
	  Enable the reusable FF-A core subsystem: version negotiation,
	  endpoint-ID discovery, feature probing and RX/TX buffer mapping,
	  built on the SMCCC v1.2 extended-register call primitive. Zephyr
	  acts as the Normal-World FF-A endpoint (e.g. to talk to OP-TEE).

if ARM_FFA

config ARM_FFA_MEM_SHARE
	bool "FF-A memory sharing (MEM_SHARE / MEM_RECLAIM)"
	depends on ARM_FFA
	help
	  Enable support for sharing memory regions with a secure partition
	  via FFA_MEM_SHARE and FFA_MEM_RECLAIM.  Required by the OP-TEE
	  FF-A transport to pass shared-memory handles to OP-TEE.

config ARM_FFA_RXTX_PAGES
	int "FF-A RX/TX buffer size (in 4 KiB pages)"
	default 1
	range 1 16
	help
	  Size of each of the RX and TX buffers mapped with FFA_RXTX_MAP,
	  expressed in 4 KiB FF-A pages. The default of 1 page (4 KiB) is
	  the FF-A minimum and is sufficient for partition discovery and
	  direct messaging.

module = ARM_FFA
module-str = arm_ffa
source "subsys/logging/Kconfig.template.log_config"

endif # ARM_FFA
```

## tests/arch/arm64/smccc_1_2/testcase.yaml
```yaml
common:
  tags: arm64 smccc ffa
tests:
  arch.arm64.smccc_1_2:
    platform_allow:
      - qemu_cortex_a53
    integration_platforms:
      - qemu_cortex_a53
```

## tests/drivers/tee/optee_ffa/testcase.yaml
```yaml
tests:
  drivers.tee.optee_ffa:
    integration_platforms:
      - qemu_cortex_a53
    platform_allow: qemu_cortex_a53
    tags: drivers tee ffa optee
```

## tests/subsys/firmware/ffa/testcase.yaml
```yaml
common:
  tags: arm64 ffa firmware
tests:
  subsys.firmware.ffa.core:
    platform_allow:
      - qemu_cortex_a53
    integration_platforms:
      - qemu_cortex_a53
```
